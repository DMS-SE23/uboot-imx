## board/advantech/mx6dldmsse23/Kconfig
```kconfig
if TARGET_MX6DLDMSSE23

config SYS_BOARD
	default "mx6dldmsse23"

config SYS_VENDOR
	default "advantech"

config SYS_CONFIG_NAME
	default "mx6dldmsse23"

endif
```

## configs/mx6dldmsse23_defconfig
```kconfig
CONFIG_ARM=y
CONFIG_ARCH_MX6=y
CONFIG_TARGET_MX6DLDMSSE23=y
CONFIG_SYS_EXTRA_OPTIONS="IMX_CONFIG=board/advantech/mx6dldmsse23/mx6dldmsse23.cfg,MX6DL,SYS_BOOT_SPINOR"
CONFIG_CMD_GPIO=y
```
